/*
 * The MIT License (MIT)
 *
 * Copyright (c) 2015 by Sergey Fetisov <fsenok@gmail.com>
 * 
 * Permission is hereby granted, free of charge, to any person obtaining a copy
 * of this software and associated documentation files (the "Software"), to deal
 * in the Software without restriction, including without limitation the rights
 * to use, copy, modify, merge, publish, distribute, sublicense, and/or sell
 * copies of the Software, and to permit persons to whom the Software is
 * furnished to do so, subject to the following conditions:
 * 
 * The above copyright notice and this permission notice shall be included in all
 * copies or substantial portions of the Software.
 * 
 * THE SOFTWARE IS PROVIDED "AS IS", WITHOUT WARRANTY OF ANY KIND, EXPRESS OR
 * IMPLIED, INCLUDING BUT NOT LIMITED TO THE WARRANTIES OF MERCHANTABILITY,
 * FITNESS FOR A PARTICULAR PURPOSE AND NONINFRINGEMENT. IN NO EVENT SHALL THE
 * AUTHORS OR COPYRIGHT HOLDERS BE LIABLE FOR ANY CLAIM, DAMAGES OR OTHER
 * LIABILITY, WHETHER IN AN ACTION OF CONTRACT, TORT OR OTHERWISE, ARISING FROM,
 * OUT OF OR IN CONNECTION WITH THE SOFTWARE OR THE USE OR OTHER DEALINGS IN THE
 * SOFTWARE.
 */

/*
 * version: 1.0 demo (7.02.2015)
 * brief:   resource file for LRNDIS lib demonstration project
 */

#ifndef RESOURCES_INC
#define RESOURCES_INC

const char page1_html[] =
	"<!DOCTYPE html>\r\n"
	"<html>\r\n"
	"<head>\r\n"
	"	<meta http-equiv=\"Content-Type\" content=\"text/html; charset=utf-8\">\r\n"
	"	<title>LRNDIS Library</title>\r\n"
	"	<style>\r\n"
	"		td {\r\n"
	"			font-family: Verdana;\r\n"
	"			text-decoration: none;\r\n"
	"			text-align: center;\r\n"
	"			letter-spacing: 0;\r\n"
	"			font-size: 1.0em;\r\n"
	"		}\r\n"
	"		a {\r\n"
	"			color: black;\r\n"
	"			font-size: 1.0em;\r\n"
	"		}\r\n"
	"	</style>\r\n"
	"\r\n"
	"</head>\r\n"
	"\r\n"
	"<body bgcolor=\"white\">\r\n"
	"<center>\r\n"
	"<table width=\"600\" bgcolor=\"white\" cellpadding=\"1\" cellspacing=\"0\">\r\n"
	"<tr bgcolor=\"#D0D0D0\">\r\n"
	"	<td><center><B>LRNDIS Library</B></center><td></td>\r\n"
	"</tr>\r\n"
	"<tr height=\"300\">\r\n"
	"<td><center>\r\n"
	"	<table cellpadding=\"0\" cellspacing=\"10\">\r\n"
	"	<tr align=\"center\">\r\n"
	"		<td><b>RNDIS</b><br>driver</td>\r\n"
	"		<td>+</td>\r\n"
	"		<td><b>LWIP</b><br>stack</td>\r\n"
	"		<td>+</td>\r\n"
	"	</tr>\r\n"
	"	</table>\r\n"
	"	<table cellpadding=\"0\" cellspacing=\"10\">\r\n"
	"	<tr align=\"center\">\r\n"
	"		<td><b>DHCP</b><br>server</td>\r\n"
	"		<td>+</td>\r\n"
	"		<td><b>DNS</b><br>server</td>\r\n"
	"		<td>+</td>\r\n"
	"		<td><b>HTTP</b><br>server</td>\r\n"
	"		<td>=</td>\r\n"
	"	</tr>\r\n"
	"	</table><br>\r\n"
	"	<B>THIS PAGE :)</B><br>\r\n"
	"	<img src=\"check.gif\">\r\n"
	"</center></td>\r\n"
	"</tr>\r\n"
	"<tr>\r\n"
	"	<td>\r\n"
	"		<table>\r\n"
	"		<tr>\r\n"
	"			<td><font color=\"silver\">prev</font></td>\r\n"
	"			<td width=\"100%\"></td>\r\n"
	"			<td><a href=\"/page2.htm\" style=\"text-decoration:none; color:#000000;\">next</a></td>\r\n"
	"		</tr>\r\n"
	"		</table>\r\n"
	"	</td>\r\n"
	"</tr>\r\n"
	"<tr bgcolor=\"#D0D0D0\">\r\n"
	"	<td>Developed by <a href=\"mailto:fsenok@gmail.com\">fse</a><td></td>\r\n"
	"</tr>\r\n"
	"</table>\r\n"
	"</center>\r\n"
	"</body>\r\n"
	"</html>\r\n";

const char page2_html[] =
	"<!DOCTYPE html>\r\n"
	"<html>\r\n"
	"<head>\r\n"
	"	<meta http-equiv=\"Content-Type\" content=\"text/html; charset=utf-8\">\r\n"
	"	<title>LRNDIS Library</title>\r\n"
	"	<style>\r\n"
	"		td {\r\n"
	"			font-family: Verdana;\r\n"
	"			text-decoration: none;\r\n"
	"			letter-spacing: 0;\r\n"
	"			font-size: 1.0em;\r\n"
	"		}\r\n"
	"		a {\r\n"
	"			color: black;\r\n"
	"			font-size: 1.0em;\r\n"
	"		}\r\n"
	"	</style>\r\n"
	"\r\n"
	"</head>\r\n"
	"\r\n"
	"<body bgcolor=\"white\">\r\n"
	"<center>\r\n"
	"<table width=\"600\" bgcolor=\"white\" cellpadding=\"1\" cellspacing=\"0\">\r\n"
	"<tr bgcolor=\"#D0D0D0\">\r\n"
	"	<td><center><B>LRNDIS Library</B></center></td>\r\n"
	"</tr>\r\n"
	"<tr height=\"300\">\r\n"
	"<td>\r\n"
	"<pre>\r\n"
	"The MIT License (MIT)\r\n"
	"\r\n"
	"Copyright (c) 2015 by Sergey Fetisov <fsenok@gmail.com>\r\n"
	"\r\n"
	"Permission is hereby granted, free of charge, to any person obtaining a copy\r\n"
	"of this software and associated documentation files (the \"Software\"), to deal\r\n"
	"in the Software without restriction, including without limitation the rights\r\n"
	"to use, copy, modify, merge, publish, distribute, sublicense, and/or sell\r\n"
	"copies of the Software, and to permit persons to whom the Software is\r\n"
	"furnished to do so, subject to the following conditions:\r\n"
	"\r\n"
	"The above copyright notice and this permission notice shall be included in all\r\n"
	"copies or substantial portions of the Software.\r\n"
	"\r\n"
	"THE SOFTWARE IS PROVIDED \"AS IS\", WITHOUT WARRANTY OF ANY KIND, EXPRESS OR\r\n"
	"IMPLIED, INCLUDING BUT NOT LIMITED TO THE WARRANTIES OF MERCHANTABILITY,\r\n"
	"FITNESS FOR A PARTICULAR PURPOSE AND NONINFRINGEMENT. IN NO EVENT SHALL THE\r\n"
	"AUTHORS OR COPYRIGHT HOLDERS BE LIABLE FOR ANY CLAIM, DAMAGES OR OTHER\r\n"
	"LIABILITY, WHETHER IN AN ACTION OF CONTRACT, TORT OR OTHERWISE, ARISING FROM,\r\n"
	"OUT OF OR IN CONNECTION WITH THE SOFTWARE OR THE USE OR OTHER DEALINGS IN THE\r\n"
	"SOFTWARE.\r\n"
	"</pre>\r\n"
	"</td>\r\n"
	"</tr>\r\n"
	"<tr>\r\n"
	"	<td>\r\n"
	"		<table>\r\n"
	"		<tr>\r\n"
	"			<td><a href=\"/\" style=\"text-decoration:none; color:#000000;\">prev</a></td>\r\n"
	"			<td width=\"100%\"></td>\r\n"
	"			<td><a href=\"/page3.htm\" style=\"text-decoration:none; color:#000000;\">next</a></td>\r\n"
	"		</tr>\r\n"
	"		</table>\r\n"
	"	</td>\r\n"
	"</tr>\r\n"
	"<tr bgcolor=\"#D0D0D0\">\r\n"
	"	<td><center>Developed by <a href=\"mailto:fsenok@gmail.com\">fse</a></center></td>\r\n"
	"</tr>\r\n"
	"</table>\r\n"
	"</center>\r\n"
	"</body>\r\n"
	"</html>\r\n";

const char page3_html[] =
	"<!DOCTYPE html>\r\n"
	"<html>\r\n"
	"<head>\r\n"
	"	<meta http-equiv=\"Content-Type\" content=\"text/html; charset=utf-8\">\r\n"
	"	<title>LRNDIS Library</title>\r\n"
	"	<style>\r\n"
	"		td {\r\n"
	"			font-family: Verdana;\r\n"
	"			text-decoration: none;\r\n"
	"			letter-spacing: 0;\r\n"
	"			font-size: 1.0em;\r\n"
	"		}\r\n"
	"		a {\r\n"
	"			color: black;\r\n"
	"			font-size: 1.0em;\r\n"
	"		}\r\n"
	"	</style>\r\n"
	"\r\n"
	"</head>\r\n"
	"\r\n"
	"<body bgcolor=\"white\">\r\n"
	"<center>\r\n"
	"<table width=\"600\" bgcolor=\"white\" cellpadding=\"1\" cellspacing=\"0\">\r\n"
	"<tr bgcolor=\"#D0D0D0\">\r\n"
	"	<td><center><B>LRNDIS Library</B></center></td>\r\n"
	"</tr>\r\n"
	"<tr height=\"300\">\r\n"
	"<td>\r\n"
	"<a href=\"https://github.com/fetisov/lrndis\">project github</a><br><br>\r\n"
	"<a href=\"http://habrahabr.ru/post/248097/\">habrahabr publication</a><br><br>\r\n"
	"<a href=\"https://msdn.microsoft.com/en-us/library/windows/hardware/ff570659%28v=vs.85%29.aspx\">Remote NDIS (RNDIS)</a><br><br>\r\n"
	"<a href=\"http://savannah.nongnu.org/projects/lwip/\">lwip stack home</a>\r\n"
	"</td>\r\n"
	"</tr>\r\n"
	"<tr>\r\n"
	"	<td>\r\n"
	"		<table>\r\n"
	"		<tr>\r\n"
	"			<td><a href=\"/page2.htm\" style=\"text-decoration:none; color:#000000;\">prev</a></td>\r\n"
	"			<td width=\"100%\"></td>\r\n"
	"			<td><font color=\"silver\">next</font></td>\r\n"
	"		</tr>\r\n"
	"		</table>\r\n"
	"	</td>\r\n"
	"</tr>\r\n"
	"<tr bgcolor=\"#D0D0D0\">\r\n"
	"	<td><center>Developed by <a href=\"mailto:fsenok@gmail.com\">fse</a></center></td>\r\n"
	"</tr>\r\n"
	"</table>\r\n"
	"</center>\r\n"
	"</body>\r\n"
	"</html>\r\n";

const char page_not_found[] =
	"<!DOCTYPE html>\r\n"
	"<html>\r\n"
	"<head>\r\n"
	"	<meta http-equiv=\"Content-Type\" content=\"text/html; charset=utf-8\">\r\n"
	"	<title>Page not found</title>\r\n"
	"	<style>\r\n"
	"		td {\r\n"
	"			font-family: Verdana;\r\n"
	"			text-decoration: none;\r\n"
	"			text-align: center;\r\n"
	"			letter-spacing: 0;\r\n"
	"			font-size: 1.0em;\r\n"
	"		}\r\n"
	"		a {\r\n"
	"			color: black;\r\n"
	"			font-size: 1.0em;\r\n"
	"		}\r\n"
	"	</style>\r\n"
	"</head>\r\n"
	"\r\n"
	"<body bgcolor=\"white\">\r\n"
	"<center>\r\n"
	"<table width=\"600\" bgcolor=\"white\" cellpadding=\"1\" cellspacing=\"0\">\r\n"
	"<tr bgcolor=\"#D0D0D0\">\r\n"
	"	<td><center><B>Page not found</B></center><td></td>\r\n"
	"</tr>\r\n"
	"<tr height=\"300\">\r\n"
	"<td>\r\n"
	"	<B><font size=\"7\" color=\"red\">!</font></B><br>\r\n"
	"	<B>Page not found :(</B>\r\n"
	"</td>\r\n"
	"</tr>\r\n"
	"<tr>\r\n"
	"	<td>\r\n"
	"		<table>\r\n"
	"		<tr>\r\n"
	"			<td></td>\r\n"
	"			<td width=\"100%\"></td>\r\n"
	"			<td nowrap=\"1\"><a href=\"/\" style=\"text-decoration:none; color:#000000;\">go home</a></td>\r\n"
	"		</tr>\r\n"
	"		</table>\r\n"
	"	</td>\r\n"
	"</tr>\r\n"
	"<tr bgcolor=\"#D0D0D0\">\r\n"
	"	<td>Developed by <a href=\"mailto:fsenok@gmail.com\">fse</a><td></td>\r\n"
	"</tr>\r\n"
	"</table>\r\n"
	"</center>\r\n"
	"</body>\r\n"
	"</html>\r\n";

const uint8_t check_png[920] =
{
	0x47, 0x49, 0x46, 0x38, 0x39, 0x61, 0x20, 0x00, 0x20, 0x00, 0xF3, 0x00, 0x00, 0xFF, 0xFF, 0xFF, 
	0xFB, 0xF3, 0x05, 0xFF, 0x64, 0x03, 0xDD, 0x09, 0x07, 0xF2, 0x08, 0x84, 0x47, 0x00, 0xA5, 0x00, 
	0x00, 0xD3, 0x02, 0xAB, 0xEA, 0x1F, 0xB7, 0x14, 0x00, 0x64, 0x12, 0x56, 0x2C, 0x05, 0x90, 0x71, 
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	0x7F, 0x4C, 0x64, 0x6F, 0x42, 0x11, 0x00, 0x3B
};

const int page1_html_size = sizeof(page1_html) - 1;
const int page2_html_size = sizeof(page2_html) - 1;
const int page3_html_size = sizeof(page3_html) - 1;
const int page_not_found_size = sizeof(page_not_found) - 1;
const int check_png_size = 920;

#endif
